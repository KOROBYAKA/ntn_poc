## CMakeLists.txt
```
# SPDX-License-Identifier: Apache-2.0
cmake_minimum_required(VERSION 3.20.0)

find_package(Zephyr REQUIRED HINTS $ENV{ZEPHYR_BASE})
project(application)

FILE(GLOB app_sources src/*.c)
target_sources(app PRIVATE ${app_sources})

target_sources(app PRIVATE
    ../common/src/dect_radio.c
)

target_include_directories(app PRIVATE
    ../common/include
)
```

## Kconfig
```
config CARRIER
	int "DECT NR+ carrier"
	default 1657

config NETWORK_ID
	int "DECT NR+ network ID"
	range 1 4294967295
	default 91

config MCS
	int "DECT NR+ MCS"
	default 1

config TX_POWER
	int "DECT NR+ TX power"
	range 0 13
	default 13

menu "Zephyr Kernel"
source "Kconfig.zephyr"
endmenu
```

## prj.conf
```kconfig
CONFIG_NRF_MODEM_LIB=y
CONFIG_MODEM_ANTENNA=n
CONFIG_NRF_MODEM_LINK_BINARY_DECT_PHY=y
CONFIG_HWINFO=y

CONFIG_LOG=y

CONFIG_NETWORK_ID=91
CONFIG_CARRIER=1657
CONFIG_MCS=1
CONFIG_TX_POWER=11
```

## src/main.c
```c
#include <stdint.h>

#include <zephyr/kernel.h>
#include <zephyr/sys/printk.h>
#include <nrf_modem_at.h>
#include <zephyr/logging/log.h>

#include "dect_radio.h"

LOG_MODULE_REGISTER(sense_main, LOG_LEVEL_INF);

int main(void)
{
	printk("Starting DECT\n");
	int err;
	uint32_t counter = 0;

	const struct dect_radio_config radio_config = {
		.network_id = CONFIG_NETWORK_ID,
		.carrier = CONFIG_CARRIER,
		.mcs = CONFIG_MCS,
		.tx_power = CONFIG_TX_POWER,
	};
	printk("Initiating DECT\n");
	err = dect_radio_init(&radio_config);

	char fw_version[128];

	err = nrf_modem_at_cmd(
		fw_version,
		sizeof(fw_version),
		"AT+CGMR"
	);

	LOG_INF("Modem FW: %s", fw_version);


	if (err != 0) {
		printk("DECT init failed: %d\n", err);
		return err;
	}

	printk("DECT sense started\n");

	while (1) {
		printk("sense loop");
		uint8_t payload[8] = {
			'S',
			'E',
			'N',
			'S',
			(uint8_t)(counter >> 24),
			(uint8_t)(counter >> 16),
			(uint8_t)(counter >> 8),
			(uint8_t)counter,
		};

		err = dect_radio_send(payload, sizeof(payload));

		if (err != 0) {
			printk("DECT TX failed: %d\n", err);
		} else {
			printk("DECT TX: %u\n", counter);
		}

		counter++;

		k_sleep(K_SECONDS(2));
	}

	return 0;
}
```

## src/uptime_worker.c
```c
/*#include <zephyr/kernel.h>
#include <string.h>
#define SLEEP_TIME 375

int uptime_worker_main(){
    uint_64_t tmp;
    char ch_buf[20];
    while(1){
    
        tmp = k_uptime_get();		
        sprintf(c_buf, "%lu", tmp);

        Message msg = {
            .message_type = DEFAULT_MSG;
            .len = strlen(ch_buf);
            .str_data = ch_buf;
        };

        //
        //TODO! 
        //Make send a uptime via DECT
        k_msleep(SLEEP_TIME);
    }
}
*/
```
