## CMakeLists.txt
```
cmake_minimum_required(VERSION 3.20.0)

find_package(Zephyr REQUIRED HINTS $ENV{ZEPHYR_BASE})
project(sink)

FILE(GLOB app_sources src/*.c)

target_sources(app PRIVATE
    ${app_sources}
    ../common/src/dect_radio.c
)

target_include_directories(app PRIVATE
    ../common/include
)
```

## Kconfig
```
config CARRIER
	int "DECT NR+ carrier"
	default 1657

config NETWORK_ID
	int "DECT NR+ network ID"
	range 1 4294967295
	default 91

config MCS
	int "DECT NR+ MCS"
	default 1

config TX_POWER
	int "DECT NR+ TX power"
	range 0 13
	default 13

menu "Zephyr Kernel"
source "Kconfig.zephyr"
endmenu
```

## prj.conf
```kconfig
CONFIG_TFM_PROFILE_TYPE_MINIMAL=y

CONFIG_NRF_MODEM_LIB=y
CONFIG_NRF_MODEM_LINK_BINARY_DECT_PHY=y
CONFIG_MODEM_ANTENNA=n
CONFIG_HWINFO=y

CONFIG_LOG_MODE_MINIMAL=y
CONFIG_SERIAL=y

CONFIG_PRINTK=y
CONFIG_CONSOLE=y
CONFIG_UART_CONSOLE=y

CONFIG_LOG=y
CONFIG_LOG_MODE_MINIMAL=y

CONFIG_NETWORK_ID=91
CONFIG_CARRIER=1657
CONFIG_MCS=1
CONFIG_TX_POWER=11
```

## src/main.c
```c
#include <stdint.h>
#include <stddef.h>

#include <zephyr/kernel.h>
#include <zephyr/sys/printk.h>

#include "dect_radio.h"

static void on_dect_rx(
	const uint8_t *data,
	size_t len,
	int16_t rssi_2)
{
	printk(
		"DECT RX: len:%u RSSI2:%d data:",
		(unsigned int)len,
		rssi_2
	);

	for (size_t i = 0; i < len; i++) {
		printk("%02x ", data[i]);
	}

	printk("\n");
}

int main(void)
{
	int err;

	const struct dect_radio_config radio_config = {
		.network_id = CONFIG_NETWORK_ID,
		.carrier = CONFIG_CARRIER,
		.mcs = CONFIG_MCS,
		.tx_power = CONFIG_TX_POWER,
	};

	printk("Starting DECT sink\n");

	err = dect_radio_init(&radio_config);

	if (err != 0) {
		printk("DECT init failed: %d\n", err);
		return err;
	}

	printk("DECT sink started\n");

	while (1) {
		printk("Starting RX window\n");

		err = dect_radio_start_rx(on_dect_rx);

		if (err != 0) {
			printk("DECT RX failed: %d\n", err);
			k_sleep(K_SECONDS(1));
		}
	}

	return 0;
}
```
